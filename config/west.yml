## config/west.yml
```yaml
manifest:
  defaults:
    revision: v0.3
  remotes:
    - name: zmkfirmware
      url-base: https://github.com/zmkfirmware
    - name: bildermankawasaki
      url-base: https://github.com/bildermankawasaki
  projects:
    - name: zmk
      remote: zmkfirmware
      import: app/west.yml
    - name: zmk-keyboard-totem
      remote: bildermankawasaki
      revision: main
  self:
    path: config
```
